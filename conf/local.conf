## conf/local.conf
```bitbake
include "application.conf"

db.default.url = "jdbc:postgresql://localhost:5432/devsunlights"


#TEST
db.test.driver=org.postgresql.Driver
db.test.url="jdbc:postgresql://192.168.0.88:5432/sunlightstest"
db.test.user=sunlights
db.test.password=sunlights
db.test.jndiName=TestDS
jpa.test=test
```
